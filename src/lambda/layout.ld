/* Generated by tools/lambda/layout.sh: the code a Lambda cold start runs, first and in the order it ran
   (docs/lambda_capabilities.md). Regenerate, do not edit. */
SECTIONS {
  .text : {
    *crt1.o(.text)
    *(".text._start_c" ".text..L_start_c")
    *(".text.__libc_start_main" ".text..L__libc_start_main")
    *(".text.__init_libc" ".text..L__init_libc")
    *(".text.compiler_rt.fastMemset" ".text..Lcompiler_rt.fastMemset")
    *(".text.static_init_tls" ".text..Lstatic_init_tls")
    *(".text.__copy_tls" ".text..L__copy_tls")
    *(".text.compiler_rt.memcpy.memcpyFast" ".text..Lcompiler_rt.memcpy.memcpyFast")
    *(".text.__init_tp" ".text..L__init_tp")
    *libc.a:*__set_thread_area.o(.text)
    *(".text.dummy1" ".text..Ldummy1")
    *(".text.libc_start_main_stage2" ".text..Llibc_start_main_stage2")
    *(".text.libc_start_init" ".text..Llibc_start_init")
    *(".text.dummy" ".text..Ldummy")
    *libmimalloc.a:*static.o(.text)
    *(".text.__pthread_mutex_lock" ".text..L__pthread_mutex_lock")
    *(".text.__clock_gettime" ".text..L__clock_gettime")
    *(".text.cgt_init" ".text..Lcgt_init")
    *(".text.__vdsosym" ".text..L__vdsosym")
    *(".text.c.string.strcmp" ".text..Lc.string.strcmp")
    *(".text.sysconf" ".text..Lsysconf")
    *(".text.__lsysinfo" ".text..L__lsysinfo")
    *(".text.__syscall_ret" ".text..L__syscall_ret")
    *(".text.syscall" ".text..Lsyscall")
    *(".text.__pthread_mutex_unlock" ".text..L__pthread_mutex_unlock")
    *(".text.__mmap" ".text..L__mmap")
    *(".text.__errno_location" ".text..L__errno_location")
    *(".text.__pthread_key_create" ".text..L__pthread_key_create")
    *(".text.__pthread_rwlock_wrlock" ".text..L__pthread_rwlock_wrlock")
    *(".text.__pthread_rwlock_timedwrlock" ".text..L__pthread_rwlock_timedwrlock")
    *(".text.__pthread_rwlock_trywrlock" ".text..L__pthread_rwlock_trywrlock")
    *(".text.__pthread_rwlock_unlock" ".text..L__pthread_rwlock_unlock")
    *(".text.pthread_setspecific" ".text..Lpthread_setspecific")
    *(".text.pthread_atfork" ".text..Lpthread_atfork")
    *(".text.c.malloc.malloc" ".text..Lc.malloc.malloc")
    *(".text.heap.SmpAllocator.alloc" ".text..Lheap.SmpAllocator.alloc")
    *(".text.heap.SmpAllocator.getCpuCount" ".text..Lheap.SmpAllocator.getCpuCount")
    *(".text.sched_getaffinity" ".text..Lsched_getaffinity")
    *(".text.do_getaffinity" ".text..Ldo_getaffinity")
    *(".text.heap.PageAllocator.map" ".text..Lheap.PageAllocator.map")
    *(".text.__munmap" ".text..L__munmap")
    *(".text.__lock" ".text..L__lock")
    *(".text.__unlock" ".text..L__unlock")
    *(".text.start.main" ".text..Lstart.main")
    *(".text.__getauxval" ".text..L__getauxval")
    *(".text.getrlimit" ".text..Lgetrlimit")
    *(".text.setrlimit" ".text..Lsetrlimit")
    *(".text.Io.Threaded.init" ".text..LIo.Threaded.init")
    *(".text.sigemptyset" ".text..Lsigemptyset")
    *(".text.__sigaction" ".text..L__sigaction")
    *(".text.__libc_sigaction" ".text..L__libc_sigaction")
    *(".text.compiler_rt.strlen" ".text..Lcompiler_rt.strlen")
    *(".text.heap.c_allocator_impl.alloc" ".text..Lheap.c_allocator_impl.alloc")
    *(".text.mem.eqlBytes" ".text..Lmem.eqlBytes")
    *(".text.main.main" ".text..Lmain.main")
    *(".text.fmt.parseInt__func_*" ".text..Lfmt.parseInt__func_*")
    *(".text.core.memory.SplitHeap.alloc" ".text..Lcore.memory.SplitHeap.alloc")
    *(".text.core.memory.miAlloc" ".text..Lcore.memory.miAlloc")
    *(".text.Io.TypeErasedQueue.putLocked" ".text..LIo.TypeErasedQueue.putLocked")
    *(".text.core.system.discoverAvailableMemory" ".text..Lcore.system.discoverAvailableMemory")
    *(".text.io.s3.Credentials.fromEnv" ".text..Lio.s3.Credentials.fromEnv")
    *(".text.io.tls.Timeouts.fromEnv" ".text..Lio.tls.Timeouts.fromEnv")
    *(".text.handler.PersistentPool.ensureForBucket" ".text..Lhandler.PersistentPool.ensureForBucket")
    *(".text.io.s3.poolCriteria" ".text..Lio.s3.poolCriteria")
    *(".text.io.s3.hostFor" ".text..Lio.s3.hostFor")
    *(".text.io.s3.awsHost" ".text..Lio.s3.awsHost")
    *(".text.io.s3.virtualHosted" ".text..Lio.s3.virtualHosted")
    *(".text.heap.ArenaAllocator.alloc" ".text..Lheap.ArenaAllocator.alloc")
    *(".text.Io.Writer.Allocating.drain" ".text..LIo.Writer.Allocating.drain")
    *(".text.heap.ArenaAllocator.remap" ".text..Lheap.ArenaAllocator.remap")
    *(".text.core.memory.SplitHeap.resize" ".text..Lcore.memory.SplitHeap.resize")
    *(".text.core.memory.miResize" ".text..Lcore.memory.miResize")
    *(".text.heap.ArenaAllocator.free" ".text..Lheap.ArenaAllocator.free")
    *(".text.io.s3.connectHostFor" ".text..Lio.s3.connectHostFor")
    *(".text.io.s3.resolveIpv4" ".text..Lio.s3.resolveIpv4")
    *(".text.getaddrinfo" ".text..Lgetaddrinfo")
    *(".text.__lookup_serv" ".text..L__lookup_serv")
    *(".text.__lookup_name" ".text..L__lookup_name")
    *(".text.c.string.strnlen" ".text..Lc.string.strnlen")
    *(".text.__lookup_ipliteral" ".text..L__lookup_ipliteral")
    *(".text.__inet_aton" ".text..L__inet_aton")
    *(".text.c.stdlib.strtoul" ".text..Lc.stdlib.strtoul")
    *(".text.c.string.strchr" ".text..Lc.string.strchr")
    *(".text.inet_pton" ".text..Linet_pton")
    *(".text.__fopen_rb_ca" ".text..L__fopen_rb_ca")
    *(".text.fgets" ".text..Lfgets")
    *(".text.__uflow" ".text..L__uflow")
    *(".text.__toread" ".text..L__toread")
    *(".text.__stdio_read" ".text..L__stdio_read")
    *(".text.c.string.memchr" ".text..Lc.string.memchr")
    *(".text.c.string.strstr" ".text..Lc.string.strstr")
    *(".text.mem.findPos__func_*" ".text..Lmem.findPos__func_*")
    *(".text.__fclose_ca" ".text..L__fclose_ca")
    *(".text.__stdio_close" ".text..L__stdio_close")
    *(".text.__get_resolv_conf" ".text..L__get_resolv_conf")
    *(".text.c.string.strncmp" ".text..Lc.string.strncmp")
    *(".text.name_from_dns" ".text..Lname_from_dns")
    *(".text.__res_mkquery" ".text..L__res_mkquery")
    *(".text.__res_msend_rc" ".text..L__res_msend_rc")
    *(".text.__pthread_setcancelstate" ".text..L__pthread_setcancelstate")
    *(".text.htons" ".text..Lhtons")
    *(".text.socket" ".text..Lsocket")
    *(".text.bind" ".text..Lbind")
    *(".text._pthread_cleanup_push" ".text..L_pthread_cleanup_push")
    *(".text.mtime" ".text..Lmtime")
    *(".text.sendto" ".text..Lsendto")
    *(".text.__syscall_cp" ".text..L__syscall_cp")
    *(".text.__syscall_cp_c" ".text..L__syscall_cp_c")
    *(".text.poll" ".text..Lpoll")
    *(".text.recvmsg" ".text..Lrecvmsg")
    *(".text.compiler_rt.memcmp" ".text..Lcompiler_rt.memcmp")
    *(".text._pthread_cleanup_pop" ".text..L_pthread_cleanup_pop")
    *(".text.cleanup" ".text..Lcleanup")
    *(".text.__dns_parse" ".text..L__dns_parse")
    *(".text.dns_parse_callback" ".text..Ldns_parse_callback")
    *(".text.c.malloc.calloc" ".text..Lc.malloc.calloc")
    *(".text.freeaddrinfo" ".text..Lfreeaddrinfo")
    *(".text.c.malloc.free" ".text..Lc.malloc.free")
    *(".text.io.s3.portFor" ".text..Lio.s3.portFor")
    *(".text.io.pool.Pool(64).joinPreconnect" ".text..Lio.pool.Pool(64).joinPreconnect")
    *(".text.pthread_attr_init" ".text..Lpthread_attr_init")
    *(".text.__acquire_ptc" ".text..L__acquire_ptc")
    *(".text.__pthread_rwlock_rdlock" ".text..L__pthread_rwlock_rdlock")
    *(".text.__pthread_rwlock_timedrdlock" ".text..L__pthread_rwlock_timedrdlock")
    *(".text.__pthread_rwlock_tryrdlock" ".text..L__pthread_rwlock_tryrdlock")
    *(".text.__release_ptc" ".text..L__release_ptc")
    *(".text.pthread_attr_setstacksize" ".text..Lpthread_attr_setstacksize")
    *(".text.pthread_attr_setguardsize" ".text..Lpthread_attr_setguardsize")
    *(".text.__pthread_create" ".text..L__pthread_create")
    *(".text.__ofl_lock" ".text..L__ofl_lock")
    *(".text.__ofl_unlock" ".text..L__ofl_unlock")
    *(".text.__membarrier_init" ".text..L__membarrier_init")
    *(".text.c.sys.mman.mprotectLinux" ".text..Lc.sys.mman.mprotectLinux")
    *(".text.__block_app_sigs" ".text..L__block_app_sigs")
    *(".text.dummy_0" ".text..Ldummy_0")
    *libc.a:*clone.o(.text)
    *(".text.__restore_sigs" ".text..L__restore_sigs")
    *(".text.pthread_attr_destroy" ".text..Lpthread_attr_destroy")
    *(".text.start" ".text..Lstart")
    *(".text.Thread.PosixThreadImpl.spawn__func_*.Instance.entryFn" ".text..LThread.PosixThreadImpl.spawn__func_*.Instance.entryFn")
    *(".text.io.tls.Connection.connect" ".text..Lio.tls.Connection.connect")
    *(".text.io.tls.serverName" ".text..Lio.tls.serverName")
    *(".text.io.tls.LazyContext.get" ".text..Lio.tls.LazyContext.get")
    *libssl.a:*ssl_lib.o(.text)
    *libssl.a:*tls_method.o(.text)
    *libcrypto.a:*mem.o(.text)
    *libcrypto.a:*thread_pthread.o(.text)
    *(".text.pthread_rwlock_init" ".text..Lpthread_rwlock_init")
    *libcrypto.a:*ex_data.o(.text)
    *libssl.a:*ssl_cert.o(.text)
    *libssl.a:*ssl_credential.o(.text)
    *libcrypto.a:*lhash.o(.text)
    *libcrypto.a:*stack.o(.text)
    *(".text.__pthread_mutex_timedlock" ".text..L__pthread_mutex_timedlock")
    *(".text.__pthread_mutex_trylock" ".text..L__pthread_mutex_trylock")
    *libssl.a:*ssl_x509.o(.text)
    *libcrypto.a:*x509_lu.o(.text)
    *libcrypto.a:*x509_vpm.o(.text)
    *libcrypto.a:*bcm.o(.text)
    *libcrypto.a:*crypto.o(.text)
    *(".text.__pthread_once" ".text..L__pthread_once")
    *(".text.__pthread_once_full" ".text..L__pthread_once_full")
    *(".text.__timedwait" ".text..L__timedwait")
    *libcrypto.a:*cpu_intel.o(.text)
    *(".text.getenv" ".text..Lgetenv")
    *(".text.c.string.strchrnul" ".text..Lc.string.strchrnul")
    *libssl.a:*ssl_cipher.o(.text)
    *(".text.c.stdlib.bsearch" ".text..Lc.stdlib.bsearch")
    *(".text.__timedwait_cp" ".text..L__timedwait_cp")
    *(".text.core.memory.SplitHeap.free" ".text..Lcore.memory.SplitHeap.free")
    *(".text.core.memory.miFree" ".text..Lcore.memory.miFree")
    *(".text._ZNSt3__110unique_ptrIN4bssl23SSLCipherPreferenceListENS1_8internal7DeleterEE5resetB8ne210100EPS2_" ".text..L_ZNSt3__110unique_ptrIN4bssl23SSLCipherPreferenceListENS1_8internal7DeleterEE5resetB8ne210100EPS2_")
    *libssl.a:*ssl_versions.o(.text)
    *libcrypto.a:*bio_mem.o(.text)
    *libcrypto.a:*bio.o(.text)
    *libcrypto.a:*buf.o(.text)
    *libcrypto.a:*pem_x509.o(.text)
    *libcrypto.a:*pem_oth.o(.text)
    *libcrypto.a:*pem_lib.o(.text)
    *libcrypto.a:*base64.o(.text)
    *libcrypto.a:*x_x509.o(.text)
    *libcrypto.a:*cbs.o(.text)
    *libcrypto.a:*tasn_dec.o(.text)
    *libcrypto.a:*asn1_lib.o(.text)
    *libcrypto.a:*tasn_new.o(.text)
    *libcrypto.a:*tasn_utl.o(.text)
    *libcrypto.a:*obj.o(.text)
    *libcrypto.a:*x_name.o(.text)
    *libcrypto.a:*x_pubkey.o(.text)
    *libcrypto.a:*a_int.o(.text)
    *libcrypto.a:*tasn_typ.o(.text)
    *libcrypto.a:*a_object.o(.text)
    *libcrypto.a:*a_type.o(.text)
    *libcrypto.a:*a_strex.o(.text)
    *libcrypto.a:*a_mbstr.o(.text)
    *libcrypto.a:*unicode.o(.text)
    *libcrypto.a:*cbb.o(.text)
    *libcrypto.a:*tasn_enc.o(.text)
    *(".text._Z42sk_STACK_OF_X509_NAME_ENTRY_call_free_funcPFvPvES_" ".text..L_Z42sk_STACK_OF_X509_NAME_ENTRY_call_free_funcPFvPvES_")
    *(".text.sk_X509_NAME_ENTRY_call_free_func" ".text..Lsk_X509_NAME_ENTRY_call_free_func")
    *libcrypto.a:*tasn_fre.o(.text)
    *libcrypto.a:*a_bitstr.o(.text)
    *libcrypto.a:*evp.o(.text)
    *libcrypto.a:*evp_asn1.o(.text)
    *(".text.compiler_rt.bcmp" ".text..Lcompiler_rt.bcmp")
    *libcrypto.a:*p_rsa_asn1.o(.text)
    *libcrypto.a:*rsa_asn1.o(.text)
    *libcrypto.a:*engine.o(.text)
    *libcrypto.a:*bn_asn1.o(.text)
    *libcrypto.a:*err.o(.text)
    *(".text.__pthread_getspecific" ".text..L__pthread_getspecific")
    *libcrypto.a:*x_algor.o(.text)
    *(".text._ZNSt3__110unique_ptrI7x509_stN4bssl8internal7DeleterEED2B8ne210100Ev" ".text..L_ZNSt3__110unique_ptrI7x509_stN4bssl8internal7DeleterEED2B8ne210100Ev")
    *libcrypto.a:*refcount.o(.text)
    *(".text.sk_X509_OBJECT_call_cmp_func" ".text..Lsk_X509_OBJECT_call_cmp_func")
    *libcrypto.a:*x509_cmp.o(.text)
    *libcrypto.a:*p_ec_asn1.o(.text)
    *libcrypto.a:*ec_asn1.o(.text)
    *libcrypto.a:*x86_64-mont-linux.o(.text)
    *(".text.io.tls.Connection.connectWith" ".text..Lio.tls.Connection.connectWith")
    *(".text.io.tls.openTcpAny" ".text..Lio.tls.openTcpAny")
    *(".text.fcntl" ".text..Lfcntl")
    *(".text.connect" ".text..Lconnect")
    *(".text.io.tls.monoMs" ".text..Lio.tls.monoMs")
    *(".text.getsockopt" ".text..Lgetsockopt")
    *(".text._ZN4bssl5ArrayItE8CopyFromENS_4SpanIKtEE" ".text..L_ZN4bssl5ArrayItE8CopyFromENS_4SpanIKtEE")
    *(".text._ZNSt3__110unique_ptrI11evp_pkey_stN4bssl8internal7DeleterEEaSB8ne210100EOS5_" ".text..L_ZNSt3__110unique_ptrI11evp_pkey_stN4bssl8internal7DeleterEEaSB8ne210100EOS5_")
    *(".text._ZNSt3__110unique_ptrI11evp_pkey_stN4bssl8internal7DeleterEED2B8ne210100Ev" ".text..L_ZNSt3__110unique_ptrI11evp_pkey_stN4bssl8internal7DeleterEED2B8ne210100Ev")
    *libssl.a:*s3_lib.o(.text)
    *libssl.a:*ssl_aead_ctx.o(.text)
    *libssl.a:*handshake.o(.text)
    *libssl.a:*ssl_transcript.o(.text)
    *libcrypto.a:*hpke.o(.text)
    *libcrypto.a:*rand.o(.text)
    *libcrypto.a:*fork_detect.o(.text)
    *(".text.__wait" ".text..L__wait")
    *(".text.c.sys.mman.madviseLinux" ".text..Lc.sys.mman.madviseLinux")
    *libcrypto.a:*forkunsafe.o(.text)
    *libcrypto.a:*urandom.o(.text)
    *libcrypto.a:*aesni-x86_64-linux.o(.text)
    *(".text.Io.net.Ip6Address.Unresolved.parse" ".text..LIo.net.Ip6Address.Unresolved.parse")
    *libssl.a:*handshake_client.o(.text)
    *libssl.a:*encrypted_client_hello.o(.text)
    *libssl.a:*extensions.o(.text)
    *libssl.a:*ssl_key_share.o(.text)
    *libcrypto.a:*curve25519.o(.text)
    *libcrypto.a:*curve25519_64_adx.o(.text)
    *libcrypto.a:*fiat_curve25519_adx_mul.o(.text)
    *libcrypto.a:*fiat_curve25519_adx_square.o(.text)
    *libssl.a:*s3_both.o(.text)
    *libssl.a:*d1_srtp.o(.text)
    *libssl.a:*tls_record.o(.text)
    *(".text.compiler_rt.memmove.memmoveFast" ".text..Lcompiler_rt.memmove.memmoveFast")
    *(".text._ZNSt3__110unique_ptrI10buf_mem_stN4bssl8internal7DeleterEE5resetB8ne210100EPS1_" ".text..L_ZNSt3__110unique_ptrI10buf_mem_stN4bssl8internal7DeleterEE5resetB8ne210100EPS1_")
    *libssl.a:*ssl_buffer.o(.text)
    *(".text.tls_client.TlsClient.processOutgoing" ".text..Ltls_client.TlsClient.processOutgoing")
    *(".text.io.tls.writeAllBy" ".text..Lio.tls.writeAllBy")
    *(".text.setsockopt" ".text..Lsetsockopt")
    *(".text.io.tls.readBy" ".text..Lio.tls.readBy")
    *(".text.read" ".text..Lread")
    *(".text.tls_client.TlsClient.processIncoming" ".text..Ltls_client.TlsClient.processIncoming")
    *libssl.a:*tls13_client.o(.text)
    *libcrypto.a:*sha256-x86_64-linux.o(.text)
    *libssl.a:*tls13_enc.o(.text)
    *libssl.a:*ssl_session.o(.text)
    *(".text.time" ".text..Ltime")
    *(".text.gettimeofday" ".text..Lgettimeofday")
    *(".text._ZN4bssl11SSLKeyShareD2Ev" ".text..L_ZN4bssl11SSLKeyShareD2Ev")
    *libcrypto.a:*ghash-x86_64-linux.o(.text)
    *(".text._ZN4bssl5ArrayIhED2Ev" ".text..L_ZN4bssl5ArrayIhED2Ev")
    *libcrypto.a:*aesni-gcm-x86_64-linux.o(.text)
    *(".text._ZNSt3__16__sortIRNS_6__lessIttEEPtEEvT0_S5_T_" ".text..L_ZNSt3__16__sortIRNS_6__lessIttEEPtEEvT0_S5_T_")
    *(".text._ZNSt3__111__introsortINS_17_ClassicAlgPolicyENS_6ranges4lessEPtLb1EEEvT1_S5_T0_NS_15iterator_traitsIS5_E15difference_typeEb" ".text..L_ZNSt3__111__introsortINS_17_ClassicAlgPolicyENS_6ranges4lessEPtLb1EEEvT1_S5_T0_NS_15iterator_traitsIS5_E15difference_typeEb")
    *libssl.a:*tls13_both.o(.text)
    *libcrypto.a:*pool.o(.text)
    *(".text._ZNSt3__110unique_ptrI22stack_st_CRYPTO_BUFFERN4bssl8internal7DeleterEEaSB8ne210100EOS5_" ".text..L_ZNSt3__110unique_ptrI22stack_st_CRYPTO_BUFFERN4bssl8internal7DeleterEEaSB8ne210100EOS5_")
    *libcrypto.a:*x509_vfy.o(.text)
    *(".text.sk_OPENSSL_STRING_call_copy_func" ".text..Lsk_OPENSSL_STRING_call_copy_func")
    *libcrypto.a:*v3_purp.o(.text)
    *libcrypto.a:*x_all.o(.text)
    *libcrypto.a:*asn1_compat.o(.text)
    *libcrypto.a:*x509_set.o(.text)
    *libcrypto.a:*x509_ext.o(.text)
    *libcrypto.a:*v3_lib.o(.text)
    *libcrypto.a:*x509_v3.o(.text)
    *libcrypto.a:*v3_bcons.o(.text)
    *(".text.sk_ASN1_OBJECT_call_free_func" ".text..Lsk_ASN1_OBJECT_call_free_func")
    *libcrypto.a:*v3_crld.o(.text)
    *libcrypto.a:*a_octet.o(.text)
    *libcrypto.a:*x509_trs.o(.text)
    *libcrypto.a:*v3_utl.o(.text)
    *libcrypto.a:*v3_genn.o(.text)
    *libcrypto.a:*a_time.o(.text)
    *libcrypto.a:*a_utctm.o(.text)
    *libcrypto.a:*posix_time.o(.text)
    *libcrypto.a:*a_verify.o(.text)
    *libcrypto.a:*algorithm.o(.text)
    *libcrypto.a:*obj_xref.o(.text)
    *libcrypto.a:*digest_extra.o(.text)
    *libcrypto.a:*evp_ctx.o(.text)
    *libcrypto.a:*p_rsa.o(.text)
    *(".text._ZN4bssl6VectorImE9MaybeGrowEv" ".text..L_ZN4bssl6VectorImE9MaybeGrowEv")
    *(".text._ZN4bssl6VectorINSt3__110unique_ptrI9bignum_stNS_8internal7DeleterEEEE9MaybeGrowEv" ".text..L_ZN4bssl6VectorINSt3__110unique_ptrI9bignum_stNS_8internal7DeleterEEEE9MaybeGrowEv")
    *(".text._ZN4bssl6VectorINSt3__110unique_ptrI9bignum_stNS_8internal7DeleterEEEE5clearEv" ".text..L_ZN4bssl6VectorINSt3__110unique_ptrI9bignum_stNS_8internal7DeleterEEEE5clearEv")
    *libcrypto.a:*x86_64-mont5-linux.o(.text)
    *(".text._ZNSt3__110unique_ptrI14bn_mont_ctx_stN4bssl8internal7DeleterEED2B8ne210100Ev" ".text..L_ZNSt3__110unique_ptrI14bn_mont_ctx_stN4bssl8internal7DeleterEED2B8ne210100Ev")
    *libcrypto.a:*policy.o(.text)
    *libcrypto.a:*v3_cpols.o(.text)
    *libcrypto.a:*v3_pmaps.o(.text)
    *(".text._Z33sk_X509_POLICY_NODE_call_cmp_funcPFiPKPKvS2_ES0_S0_" ".text..L_Z33sk_X509_POLICY_NODE_call_cmp_funcPFiPKPKvS2_ES0_S0_")
    *(".text.sk_POLICY_MAPPING_call_free_func" ".text..Lsk_POLICY_MAPPING_call_free_func")
    *(".text._Z39sk_X509_POLICY_NODE_call_delete_if_funcPFiPvS_ES_S_" ".text..L_Z39sk_X509_POLICY_NODE_call_delete_if_funcPFiPvS_ES_S_")
    *(".text.sk_POLICYINFO_call_cmp_func" ".text..Lsk_POLICYINFO_call_cmp_func")
    *(".text._Z35sk_X509_POLICY_LEVEL_call_free_funcPFvPvES_" ".text..L_Z35sk_X509_POLICY_LEVEL_call_free_funcPFvPvES_")
    *(".text._Z34sk_X509_POLICY_NODE_call_free_funcPFvPvES_" ".text..L_Z34sk_X509_POLICY_NODE_call_free_funcPFvPvES_")
    *(".text.sk_OPENSSL_STRING_call_free_func" ".text..Lsk_OPENSSL_STRING_call_free_func")
    *(".text.sk_X509_call_free_func" ".text..Lsk_X509_call_free_func")
    *libssl.a:*ssl_privkey.o(.text)
    *(".text.sk_CRYPTO_BUFFER_call_copy_func" ".text..Lsk_CRYPTO_BUFFER_call_copy_func")
    *(".text._ZN4bssl5ArrayIhE8CopyFromENS_4SpanIKhEE" ".text..L_ZN4bssl5ArrayIhE8CopyFromENS_4SpanIKhEE")
    *(".text._ZZN4bssl8internal11DeleterImplI22stack_st_CRYPTO_BUFFERvE4FreeEPS2_ENUlPFvPvES5_E_8__invokeES7_S5_" ".text..L_ZZN4bssl8internal11DeleterImplI22stack_st_CRYPTO_BUFFERvE4FreeEPS2_ENUlPFvPvES5_E_8__invokeES7_S5_")
    *(".text.pthread_rwlock_destroy" ".text..Lpthread_rwlock_destroy")
    *libssl.a:*s3_pkt.o(.text)
    *(".text.__pthread_exit" ".text..L__pthread_exit")
    *(".text.sleep" ".text..Lsleep")
    *(".text.nanosleep" ".text..Lnanosleep")
    *(".text.__clock_nanosleep" ".text..L__clock_nanosleep")
    *(".text.pthread_mutex_destroy" ".text..Lpthread_mutex_destroy")
    *(".text.__vm_lock" ".text..L__vm_lock")
    *(".text.__vm_unlock" ".text..L__vm_unlock")
    *(".text.core.memory.SplitHeap.remap" ".text..Lcore.memory.SplitHeap.remap")
    *(".text.core.memory.miRemap" ".text..Lcore.memory.miRemap")
    *(".text.json.Scanner.next" ".text..Ljson.Scanner.next")
    *(".text.BitStack.push" ".text..LBitStack.push")
    *(".text.json.Scanner.nextAllocMax" ".text..Ljson.Scanner.nextAllocMax")
    *(".text.json.Scanner.peekNextTokenType" ".text..Ljson.Scanner.peekNextTokenType")
    *(".text.json.Scanner.skipWhitespaceCheckEnd" ".text..Ljson.Scanner.skipWhitespaceCheckEnd")
    *(".text.handler.handleWithColumns" ".text..Lhandler.handleWithColumns")
    *(".text.json.static.parseFromTokenSourceLeaky__func_*" ".text..Ljson.static.parseFromTokenSourceLeaky__func_*")
    *(".text.json.static.innerParse__func_*" ".text..Ljson.static.innerParse__func_*")
    *(".text.json.dynamic.handleCompleteValue__func_*" ".text..Ljson.dynamic.handleCompleteValue__func_*")
    *(".text.array_list.AlignedManaged(json.dynamic.Value,null).ensureTotalCapacity" ".text..Larray_list.AlignedManaged(json.dynamic.Value,null).ensureTotalCapacity")
    *(".text.json.static.freeAllocated" ".text..Ljson.static.freeAllocated")
    *(".text.json.static.fillDefaultStructValues__func_*" ".text..Ljson.static.fillDefaultStructValues__func_*")
    *(".text.request.Fields.string__func_*" ".text..Lrequest.Fields.string__func_*")
    *(".text.request.Fields.strings__func_*" ".text..Lrequest.Fields.strings__func_*")
    *(".text.mem.Allocator.alloc__func_*" ".text..Lmem.Allocator.alloc__func_*")
    *(".text.core.system.onLambda" ".text..Lcore.system.onLambda")
    *(".text.handler.runAggregate" ".text..Lhandler.runAggregate")
    *(".text.engine.aggregate.runQuery" ".text..Lengine.aggregate.runQuery")
    *(".text.engine.csv_write.csvInput" ".text..Lengine.csv_write.csvInput")
    *(".text.engine.aggregate.executeAggregateOver__func_*" ".text..Lengine.aggregate.executeAggregateOver__func_*")
    *(".text.engine.s3_fetch.s3FetchWindow" ".text..Lengine.s3_fetch.s3FetchWindow")
    *(".text.engine.input.openInputs" ".text..Lengine.input.openInputs")
    *(".text.local_fs.mapFile" ".text..Llocal_fs.mapFile")
    *(".text.posix.openatZ" ".text..Lposix.openatZ")
    *(".text.openat" ".text..Lopenat")
    *(".text.local_fs.fileSize" ".text..Llocal_fs.fileSize")
    *(".text.__lseek" ".text..L__lseek")
    *(".text.io.local_reader.Policy.fromEnv" ".text..Lio.local_reader.Policy.fromEnv")
    *(".text.engine.aggregate.joinedMetas" ".text..Lengine.aggregate.joinedMetas")
    *(".text.engine.input.materializeMetas" ".text..Lengine.input.materializeMetas")
    *(".text.core.parquet.metadata.openFooter" ".text..Lcore.parquet.metadata.openFooter")
    *(".text.core.schema.FileMetaData.read" ".text..Lcore.schema.FileMetaData.read")
    *(".text.core.thrift.Reader.readZigZag__func_*" ".text..Lcore.thrift.Reader.readZigZag__func_*")
    *(".text.core.thrift.Reader.readVarInt__func_*" ".text..Lcore.thrift.Reader.readVarInt__func_*")
    *(".text.core.thrift.Reader.skipDepth" ".text..Lcore.thrift.Reader.skipDepth")
    *(".text.core.schema.Statistics.read" ".text..Lcore.schema.Statistics.read")
    *(".text.core.parquet.writer_statistics.policy" ".text..Lcore.parquet.writer_statistics.policy")
    *(".text.core.parquet.metadata.checkFooterFields" ".text..Lcore.parquet.metadata.checkFooterFields")
    *(".text.core.parquet.metadata.reconcileChunkPaths" ".text..Lcore.parquet.metadata.reconcileChunkPaths")
    *(".text.core.schema.LeafIterator.next" ".text..Lcore.schema.LeafIterator.next")
    *(".text.core.schema.FileMetaData.indexLeaves" ".text..Lcore.schema.FileMetaData.indexLeaves")
    *(".text.unlikely.hash_map.Custom(\[\]const \[\]const u8,u32,core.schema.LeafIndex.PathContext,80).grow" ".text.unlikely..Lhash_map.Custom(\[\]const \[\]const u8,u32,core.schema.LeafIndex.PathContext,80).grow")
    *(".text.hash.wyhash.Wyhash.final" ".text..Lhash.wyhash.Wyhash.final")
    *(".text.hash_map.Custom(\[\]const \[\]const u8,core.parquet.metadata.leafLabels.PathUse,core.parquet.metadata.PathContext,80).getIndex__func_*" ".text..Lhash_map.Custom(\[\]const \[\]const u8,core.parquet.metadata.leafLabels.PathUse,core.parquet.metadata.PathContext,80).getIndex__func_*")
    *(".text.hash.wyhash.Wyhash.update" ".text..Lhash.wyhash.Wyhash.update")
    *(".text.engine.types.QueryArgs.bound" ".text..Lengine.types.QueryArgs.bound")
    *(".text.core.filter.parser.parseDisjunction__func_*" ".text..Lcore.filter.parser.parseDisjunction__func_*")
    *(".text.core.filter.parser.Cursor.nextWord" ".text..Lcore.filter.parser.Cursor.nextWord")
    *(".text.core.filter.parser.parseConjunction__func_*" ".text..Lcore.filter.parser.parseConjunction__func_*")
    *(".text.core.filter.parser.parseNegation__func_*" ".text..Lcore.filter.parser.parseNegation__func_*")
    *(".text.core.filter.parser.groupBody" ".text..Lcore.filter.parser.groupBody")
    *(".text.core.filter.parser.Cursor.find" ".text..Lcore.filter.parser.Cursor.find")
    *(".text.core.filter.parser.parseComparisonLeaf__func_*" ".text..Lcore.filter.parser.parseComparisonLeaf__func_*")
    *(".text.core.filter.parser.findComparison" ".text..Lcore.filter.parser.findComparison")
    *(".text.core.filter.parser.parseOperandSyntax" ".text..Lcore.filter.parser.parseOperandSyntax")
    *(".text.core.filter.parser.bindOperand" ".text..Lcore.filter.parser.bindOperand")
    *(".text.core.filter.parser.resolveCol" ".text..Lcore.filter.parser.resolveCol")
    *(".text.core.parquet.metadata.unquoteIdent" ".text..Lcore.parquet.metadata.unquoteIdent")
    *(".text.core.parquet.metadata.resolveColumn" ".text..Lcore.parquet.metadata.resolveColumn")
    *(".text.core.parquet.metadata.ColumnHits.find" ".text..Lcore.parquet.metadata.ColumnHits.find")
    *(".text.core.filter.parser.buildOperandComparison" ".text..Lcore.filter.parser.buildOperandComparison")
    *(".text.core.filter.parser.parseDateTimeNs" ".text..Lcore.filter.parser.parseDateTimeNs")
    *(".text.compiler_rt.udivmod.__divti3" ".text..Lcompiler_rt.udivmod.__divti3")
    *(".text.compiler_rt.udivmod.udivmod__func_*" ".text..Lcompiler_rt.udivmod.udivmod__func_*")
    *(".text.core.filter.parser.bindExact" ".text..Lcore.filter.parser.bindExact")
    *(".text.core.filter.ast.join" ".text..Lcore.filter.ast.join")
    *(".text.engine.input.loadLocalMembership" ".text..Lengine.input.loadLocalMembership")
    *(".text.core.filter.membership.load" ".text..Lcore.filter.membership.load")
    *(".text.core.filter.membership.collectLeaves" ".text..Lcore.filter.membership.collectLeaves")
    *(".text.core.filter.membership.eqColumn" ".text..Lcore.filter.membership.eqColumn")
    *(".text.core.filter.nanprobe.load" ".text..Lcore.filter.nanprobe.load")
    *(".text.core.filter.ast.withTrust" ".text..Lcore.filter.ast.withTrust")
    *(".text.core.filter.nanprobe.floatColumns" ".text..Lcore.filter.nanprobe.floatColumns")
    *(".text.engine.input.chooseLocalIo" ".text..Lengine.input.chooseLocalIo")
    *(".text.engine.s3_fetch.planRanges" ".text..Lengine.s3_fetch.planRanges")
    *(".text.core.expr.parser.parseGroupByOf" ".text..Lcore.expr.parser.parseGroupByOf")
    *(".text.core.expr.parser.parseExpr__func_*" ".text..Lcore.expr.parser.parseExpr__func_*")
    *(".text.core.expr.parser.parseFactor__func_*" ".text..Lcore.expr.parser.parseFactor__func_*")
    *(".text.core.expr.parser.Lexer.next" ".text..Lcore.expr.parser.Lexer.next")
    *(".text.core.expr.parser.bindColumn" ".text..Lcore.expr.parser.bindColumn")
    *(".text.core.parquet.metadata.leafPathSegments" ".text..Lcore.parquet.metadata.leafPathSegments")
    *(".text.core.schema.FileMetaData.leafAtPath" ".text..Lcore.schema.FileMetaData.leafAtPath")
    *(".text.core.expr.parser.parseAggList" ".text..Lcore.expr.parser.parseAggList")
    *(".text.core.expr.parser.resolveAggFunc" ".text..Lcore.expr.parser.resolveAggFunc")
    *(".text.core.expr.parser.aggSecond" ".text..Lcore.expr.parser.aggSecond")
    *(".text.core.expr.parser.resolveArgName" ".text..Lcore.expr.parser.resolveArgName")
    *(".text.core.expr.parser.checkSketchColumn" ".text..Lcore.expr.parser.checkSketchColumn")
    *(".text.core.expr.parser.bindAggregate" ".text..Lcore.expr.parser.bindAggregate")
    *(".text.core.expr.parser.makeBinopIn" ".text..Lcore.expr.parser.makeBinopIn")
    *(".text.core.expr.ast.Expr.decSpec" ".text..Lcore.expr.ast.Expr.decSpec")
    *(".text.core.expr.parser.asciiEqIgnoreCase" ".text..Lcore.expr.parser.asciiEqIgnoreCase")
    *(".text.core.agg_plan.Plan.init" ".text..Lcore.agg_plan.Plan.init")
    *(".text.core.filter.ast.Filter.collectColumns" ".text..Lcore.filter.ast.Filter.collectColumns")
    *(".text.array_list.Aligned(i64,null).append" ".text..Larray_list.Aligned(i64,null).append")
    *(".text.core.agg_plan.consumedColumns" ".text..Lcore.agg_plan.consumedColumns")
    *(".text.core.expr.ast.Expr.collectColumns" ".text..Lcore.expr.ast.Expr.collectColumns")
    *(".text.core.filter.ast.markNonMandatoryColumns" ".text..Lcore.filter.ast.markNonMandatoryColumns")
    *(".text.core.filter.prune.pruneRowGroup" ".text..Lcore.filter.prune.pruneRowGroup")
    *(".text.core.filter.prune.valueStats" ".text..Lcore.filter.prune.valueStats")
    *(".text.core.parquet.statistics.chunkStats" ".text..Lcore.parquet.statistics.chunkStats")
    *(".text.core.parquet.statistics.boundsInverted" ".text..Lcore.parquet.statistics.boundsInverted")
    *(".text.core.filter.prune.flatLeaf" ".text..Lcore.filter.prune.flatLeaf")
    *(".text.core.filter.encoded.rangeAlwaysMatches__func_*" ".text..Lcore.filter.encoded.rangeAlwaysMatches__func_*")
    *(".text.io.local_reader.sampleRanges" ".text..Lio.local_reader.sampleRanges")
    *(".text.sort.block.block__func_*" ".text..Lsort.block.block__func_*")
    *(".text.sort.block.swap__func_*" ".text..Lsort.block.swap__func_*")
    *(".text.posix.read" ".text..Lposix.read")
    *(".text.c.unistd.close" ".text..Lc.unistd.close")
    *(".text.local_fs.deviceQueue" ".text..Llocal_fs.deviceQueue")
    *(".text.engine.env.sketchFromEnv" ".text..Lengine.env.sketchFromEnv")
    *(".text.engine.input.localReaderInputs" ".text..Lengine.input.localReaderInputs")
    *(".text.core.scan.execute.runMultiAggregate" ".text..Lcore.scan.execute.runMultiAggregate")
    *(".text.core.scan.execute.joinPaths" ".text..Lcore.scan.execute.joinPaths")
    *(".text.core.scan.execute.prepareAggregateWithMetas__func_*" ".text..Lcore.scan.execute.prepareAggregateWithMetas__func_*")
    *(".text.core.scan.execute.validateAggregateSchemas" ".text..Lcore.scan.execute.validateAggregateSchemas")
    *(".text.core.scan.execute.bindAggregateQuery" ".text..Lcore.scan.execute.bindAggregateQuery")
    *(".text.core.scan.binding.nameUnaliasedAggs" ".text..Lcore.scan.binding.nameUnaliasedAggs")
    *(".text.core.scan.binding.leafLabel" ".text..Lcore.scan.binding.leafLabel")
    *(".text.core.scan.owner_support.passThroughSource" ".text..Lcore.scan.owner_support.passThroughSource")
    *(".text.core.scan.binding.bindGroupOutputs" ".text..Lcore.scan.binding.bindGroupOutputs")
    *(".text.core.expr.group_dependencies.dependency" ".text..Lcore.expr.group_dependencies.dependency")
    *(".text.core.scan.execute.tryEarlyOwners__func_*" ".text..Lcore.scan.execute.tryEarlyOwners__func_*")
    *(".text.core.agg_plan.OwnerProgram.init" ".text..Lcore.agg_plan.OwnerProgram.init")
    *(".text.core.scan.owner_integer.inlineIntegerAnswer__func_*" ".text..Lcore.scan.owner_integer.inlineIntegerAnswer__func_*")
    *(".text.core.scan.owner_bytes.inlineMsdAnswer__func_*" ".text..Lcore.scan.owner_bytes.inlineMsdAnswer__func_*")
    *(".text.core.scan.plan.planAggregate" ".text..Lcore.scan.plan.planAggregate")
    *(".text.core.scan.plan.rankingCall" ".text..Lcore.scan.plan.rankingCall")
    *(".text.core.filter.prune.passFraction" ".text..Lcore.filter.prune.passFraction")
    *(".text.core.expr.agg_dense.shapeOk" ".text..Lcore.expr.agg_dense.shapeOk")
    *(".text.core.expr.agg_dense.numericCalls" ".text..Lcore.expr.agg_dense.numericCalls")
    *(".text.core.ndv.footerEntries" ".text..Lcore.ndv.footerEntries")
    *(".text.core.ndv.probeRanges" ".text..Lcore.ndv.probeRanges")
    *(".text.core.ndv.planReads" ".text..Lcore.ndv.planReads")
    *(".text.engine.input.DictProbeSink.add" ".text..Lengine.input.DictProbeSink.add")
    *(".text.core.ndv.collectRetaining" ".text..Lcore.ndv.collectRetaining")
    *(".text.core.schema.PageHeader.read" ".text..Lcore.schema.PageHeader.read")
    *(".text.core.ndv.unionBoundForIdentity" ".text..Lcore.ndv.unionBoundForIdentity")
    *(".text.unlikely.hash_map.Custom(\[\]const u8,u32,core.bytes.KeyContext,80).grow" ".text.unlikely..Lhash_map.Custom(\[\]const u8,u32,core.bytes.KeyContext,80).grow")
    *(".text.core.ndv.Worker.run" ".text..Lcore.ndv.Worker.run")
    *(".text.heap.ArenaAllocator.reset" ".text..Lheap.ArenaAllocator.reset")
    *(".text.core.parquet.page.PageReader.next" ".text..Lcore.parquet.page.PageReader.next")
    *(".text.core.parquet.compression.decompress" ".text..Lcore.parquet.compression.decompress")
    *(".text.core.parquet.compression.decompressInto" ".text..Lcore.parquet.compression.decompressInto")
    *(".text.core.parquet.compression.ThreadCodecs.current" ".text..Lcore.parquet.compression.ThreadCodecs.current")
    *libzstd.a:*zstd_decompress.o(.text)
    *(".text.core.parquet.compression.pageAlloc" ".text..Lcore.parquet.compression.pageAlloc")
    *libzstd.a:*zstd_ddict.o(.text)
    *libzstd.a:*zstd_decompress_block.o(.text)
    *libzstd.a:*zstd_common.o(.text)
    *(".text.hash.wyhash.Wyhash.hash" ".text..Lhash.wyhash.Wyhash.hash")
    *(".text.hash_map.Custom(\[\]const u8,u32,core.bytes.KeyContext,80).getIndex__func_*" ".text..Lhash_map.Custom(\[\]const u8,u32,core.bytes.KeyContext,80).getIndex__func_*")
    *(".text.array_list.Aligned(\[\]u8,null).append" ".text..Larray_list.Aligned(\[\]u8,null).append")
    *(".text.hash_map.Custom(\[\]const u8,u32,core.bytes.KeyContext,80).getOrPutAssumeCapacityAdapted__func_*" ".text..Lhash_map.Custom(\[\]const u8,u32,core.bytes.KeyContext,80).getOrPutAssumeCapacityAdapted__func_*")
    *(".text.core.ndv.buildAxis" ".text..Lcore.ndv.buildAxis")
    *(".text.core.expr.aggregate.distinct.DistinctSet.deinit" ".text..Lcore.expr.aggregate.distinct.DistinctSet.deinit")
    *(".text.core.memory.SharedBudget.release" ".text..Lcore.memory.SharedBudget.release")
    *(".text.core.expr.agg_dense.orderSensitive" ".text..Lcore.expr.agg_dense.orderSensitive")
    *(".text.core.expr.agg_dense.numericFits" ".text..Lcore.expr.agg_dense.numericFits")
    *(".text.core.hw.forCpu" ".text..Lcore.hw.forCpu")
    *(".text.core.hw.readFile" ".text..Lcore.hw.readFile")
    *(".text.core.hw.parseCpuList" ".text..Lcore.hw.parseCpuList")
    *(".text.core.scan.census.denseLimit" ".text..Lcore.scan.census.denseLimit")
    *(".text.core.expr.agg_dense.charge" ".text..Lcore.expr.agg_dense.charge")
    *(".text.core.expr.agg_dense.laneBytes" ".text..Lcore.expr.agg_dense.laneBytes")
    *(".text.core.scan.plan.passShare" ".text..Lcore.scan.plan.passShare")
    *(".text.core.memory.SharedBudget.drawExact" ".text..Lcore.memory.SharedBudget.drawExact")
    *(".text.core.expr.agg_dense.sumCall" ".text..Lcore.expr.agg_dense.sumCall")
    *(".text.core.huge_pages.worthAdvising" ".text..Lcore.huge_pages.worthAdvising")
    *(".text.core.scan.plan.partAggSupported" ".text..Lcore.scan.plan.partAggSupported")
    *(".text.core.scan.read_ahead.ReadAhead.forScan" ".text..Lcore.scan.read_ahead.ReadAhead.forScan")
    *(".text.core.scan.worker.runWorkers" ".text..Lcore.scan.worker.runWorkers")
    *(".text.core.scan.worker.workerRun" ".text..Lcore.scan.worker.workerRun")
    *(".text.core.memory.SharedBudget.available" ".text..Lcore.memory.SharedBudget.available")
    *(".text.core.consumer.scan.scanRGForAgg" ".text..Lcore.consumer.scan.scanRGForAgg")
    *(".text.core.consumer.scan.exactTileTarget" ".text..Lcore.consumer.scan.exactTileTarget")
    *(".text.core.expr.exact_tiles.admits" ".text..Lcore.expr.exact_tiles.admits")
    *(".text.core.expr.exact_tiles.treeAdmits" ".text..Lcore.expr.exact_tiles.treeAdmits")
    *(".text.core.consumer.scan.scanRGForAggSpecialized" ".text..Lcore.consumer.scan.scanRGForAggSpecialized")
    *(".text.core.consumer.scan.planDecode" ".text..Lcore.consumer.scan.planDecode")
    *(".text.core.consumer.pruning.pruneFilterPages" ".text..Lcore.consumer.pruning.pruneFilterPages")
    *(".text.core.consumer.pruning.compactRows" ".text..Lcore.consumer.pruning.compactRows")
    *(".text.core.consumer.plan.foldWantsCodes" ".text..Lcore.consumer.plan.foldWantsCodes")
    *(".text.core.consumer.scan.foldWholeGrouped" ".text..Lcore.consumer.scan.foldWholeGrouped")
    *(".text.core.consumer.scan.foldFromStats" ".text..Lcore.consumer.scan.foldFromStats")
    *(".text.core.consumer.scan.publishLookups" ".text..Lcore.consumer.scan.publishLookups")
    *(".text.core.consumer.scan.foldWholeScalar" ".text..Lcore.consumer.scan.foldWholeScalar")
    *(".text.core.join.lookup.GroupJoin.foldRowGroup" ".text..Lcore.join.lookup.GroupJoin.foldRowGroup")
    *(".text.core.row_group_arena.RowGroupArena.nextRowGroup" ".text..Lcore.row_group_arena.RowGroupArena.nextRowGroup")
    *(".text.core.consumer.budget.decodeEstimate" ".text..Lcore.consumer.budget.decodeEstimate")
    *(".text.core.consumer.plan.streamByteArray" ".text..Lcore.consumer.plan.streamByteArray")
    *(".text.core.consumer.plan.fusion" ".text..Lcore.consumer.plan.fusion")
    *(".text.core.filter.ast.reads" ".text..Lcore.filter.ast.reads")
    *(".text.core.consumer.target.AggTarget.codedKey" ".text..Lcore.consumer.target.AggTarget.codedKey")
    *(".text.core.consumer.workspace.cacheDictionary" ".text..Lcore.consumer.workspace.cacheDictionary")
    *(".text.core.parquet.page.PageReader.peek" ".text..Lcore.parquet.page.PageReader.peek")
    *(".text.core.consumer.pruning.loadPageIndexes" ".text..Lcore.consumer.pruning.loadPageIndexes")
    *(".text.core.row_group_arena.RowGroupArena.alloc" ".text..Lcore.row_group_arena.RowGroupArena.alloc")
    *(".text.core.huge_pages.Region.regionAlloc" ".text..Lcore.huge_pages.Region.regionAlloc")
    *(".text.core.consumer.pruning.collectConjunctiveLeaves" ".text..Lcore.consumer.pruning.collectConjunctiveLeaves")
    *(".text.core.consumer.plan.planCodeUses" ".text..Lcore.consumer.plan.planCodeUses")
    *(".text.core.consumer.plan.markFilter" ".text..Lcore.consumer.plan.markFilter")
    *(".text.core.consumer.plan.markExprValues" ".text..Lcore.consumer.plan.markExprValues")
    *(".text.core.expr.agg_coded.rewriteSource" ".text..Lcore.expr.agg_coded.rewriteSource")
    *(".text.core.consumer.plan.payloadColumns" ".text..Lcore.consumer.plan.payloadColumns")
    *(".text.core.row_group_arena.RowGroupArena.free" ".text..Lcore.row_group_arena.RowGroupArena.free")
    *(".text.core.consumer.plan.GatedFilter.init" ".text..Lcore.consumer.plan.GatedFilter.init")
    *(".text.core.consumer.scan.joinSlotArrays" ".text..Lcore.consumer.scan.joinSlotArrays")
    *(".text.core.consumer.plan.ChunkDecoder.column" ".text..Lcore.consumer.plan.ChunkDecoder.column")
    *(".text.core.parquet.column.chunkOptions" ".text..Lcore.parquet.column.chunkOptions")
    *(".text.core.consumer.target.AggTarget.exactInputs" ".text..Lcore.consumer.target.AggTarget.exactInputs")
    *(".text.core.consumer.target.AggTarget.exactTree" ".text..Lcore.consumer.target.AggTarget.exactTree")
    *(".text.core.consumer.agg_column.decodeAggColumnCoded" ".text..Lcore.consumer.agg_column.decodeAggColumnCoded")
    *(".text.core.consumer.column.codedOrValues__func_*" ".text..Lcore.consumer.column.codedOrValues__func_*")
    *(".text.core.parquet.column.ColumnChunkReader(i32).readAllCodes" ".text..Lcore.parquet.column.ColumnChunkReader(i32).readAllCodes")
    *(".text.core.parquet.column.ColumnChunkReader(i32).advancePage" ".text..Lcore.parquet.column.ColumnChunkReader(i32).advancePage")
    *(".text.core.parquet.page.PageReader.dictionaryBuffer" ".text..Lcore.parquet.page.PageReader.dictionaryBuffer")
    *libzstd.a:*huf_decompress.o(.text)
    *libzstd.a:*entropy_common.o(.text)
    *libzstd.a:*fse_decompress.o(.text)
    *libzstd.a:*huf_decompress_amd64.o(.text)
    *(".text.core.parquet.column.ColumnChunkReader(f32).dictBuffer" ".text..Lcore.parquet.column.ColumnChunkReader(f32).dictBuffer")
    *(".text.core.parquet.page.PageReader.pageBuffer" ".text..Lcore.parquet.page.PageReader.pageBuffer")
    *(".text.core.parquet.column.ColumnChunkReader(i32).installDefLevels" ".text..Lcore.parquet.column.ColumnChunkReader(i32).installDefLevels")
    *(".text.core.parquet.encoding.hybrid_rle.HybridRleDecoder.readNextRun" ".text..Lcore.parquet.encoding.hybrid_rle.HybridRleDecoder.readNextRun")
    *(".text.core.parquet.column.ColumnChunkReader(i32).installValues" ".text..Lcore.parquet.column.ColumnChunkReader(i32).installValues")
    *(".text.core.parquet.column.ColumnChunkReader(i32).readPageCodes" ".text..Lcore.parquet.column.ColumnChunkReader(i32).readPageCodes")
    *(".text.core.parquet.encoding.hybrid_rle.HybridRleDecoder.decode" ".text..Lcore.parquet.encoding.hybrid_rle.HybridRleDecoder.decode")
    *(".text.core.parquet.encoding.hybrid_rle.HybridRleDecoder.decodeBitPacked" ".text..Lcore.parquet.encoding.hybrid_rle.HybridRleDecoder.decodeBitPacked")
    *(".text.core.consumer.column.checkRowShape" ".text..Lcore.consumer.column.checkRowShape")
    *(".text.core.filter.eval.evaluate" ".text..Lcore.filter.eval.evaluate")
    *(".text.core.filter.eval.evalCodedLeaf" ".text..Lcore.filter.eval.evalCodedLeaf")
    *(".text.core.filter.eval.Batch.Column.dictColumn" ".text..Lcore.filter.eval.Batch.Column.dictColumn")
    *(".text.core.filter.eval.evalLeaf__func_*" ".text..Lcore.filter.eval.evalLeaf__func_*")
    *(".text.core.filter.eval.applyCodeMatch" ".text..Lcore.filter.eval.applyCodeMatch")
    *(".text.core.consumer.plan.adviseGated" ".text..Lcore.consumer.plan.adviseGated")
    *(".text.core.filter.selection.SelectionVector.anyInRange" ".text..Lcore.filter.selection.SelectionVector.anyInRange")
    *(".text.core.scan.read_ahead.ReadAhead.adviseOpaque" ".text..Lcore.scan.read_ahead.ReadAhead.adviseOpaque")
    *(".text.core.consumer.agg_column.decodeAggColumn" ".text..Lcore.consumer.agg_column.decodeAggColumn")
    *(".text.core.parquet.decimal.decodeColumnExact" ".text..Lcore.parquet.decimal.decodeColumnExact")
    *(".text.core.parquet.decimal.decodeFlbaBackedI128" ".text..Lcore.parquet.decimal.decodeFlbaBackedI128")
    *(".text.core.parquet.decimal.flbaToI128" ".text..Lcore.parquet.decimal.flbaToI128")
    *(".text.core.parquet.decimal.decodeLevels" ".text..Lcore.parquet.decimal.decodeLevels")
    *(".text.core.parquet.encoding.hybrid_rle.decodeLevels" ".text..Lcore.parquet.encoding.hybrid_rle.decodeLevels")
    *(".text.compiler_rt.float_from_int.__floattidf" ".text..Lcompiler_rt.float_from_int.__floattidf")
    *(".text.core.expr.agg_coded.materialize" ".text..Lcore.expr.agg_coded.materialize")
    *(".text.core.row_group_arena.RowGroupArena.remap" ".text..Lcore.row_group_arena.RowGroupArena.remap")
    *(".text.core.huge_pages.Region.regionResize" ".text..Lcore.huge_pages.Region.regionResize")
    *(".text.core.consumer.plan.emptinessWant" ".text..Lcore.consumer.plan.emptinessWant")
    *(".text.core.parquet.column.ColumnChunkReader(\[\]const u8).readAllCodes" ".text..Lcore.parquet.column.ColumnChunkReader(\[\]const u8).readAllCodes")
    *(".text.core.parquet.column.ColumnChunkReader(\[\]const u8).advancePage" ".text..Lcore.parquet.column.ColumnChunkReader(\[\]const u8).advancePage")
    *(".text.core.parquet.column.ColumnChunkReader(\[\]const u8).installDictionary" ".text..Lcore.parquet.column.ColumnChunkReader(\[\]const u8).installDictionary")
    *(".text.core.parquet.column.ColumnChunkReader(\[\]const u8).dictBuffer" ".text..Lcore.parquet.column.ColumnChunkReader(\[\]const u8).dictBuffer")
    *(".text.core.parquet.encoding.plain.ByteArrayDecoder.decode" ".text..Lcore.parquet.encoding.plain.ByteArrayDecoder.decode")
    *(".text.core.parquet.column.ColumnChunkReader(\[\]const u8).installDefLevels" ".text..Lcore.parquet.column.ColumnChunkReader(\[\]const u8).installDefLevels")
    *(".text.core.parquet.column.ColumnChunkReader(\[\]const u8).installValues" ".text..Lcore.parquet.column.ColumnChunkReader(\[\]const u8).installValues")
    *(".text.core.parquet.column.ColumnChunkReader(\[\]const u8).readPageCodes" ".text..Lcore.parquet.column.ColumnChunkReader(\[\]const u8).readPageCodes")
    *(".text.core.expr.agg_coded.codePlainKeys" ".text..Lcore.expr.agg_coded.codePlainKeys")
    *(".text.core.expr.agg_dense.Lanes.foldKeys" ".text..Lcore.expr.agg_dense.Lanes.foldKeys")
    *(".text.core.expr.agg_dense.Domain.bind" ".text..Lcore.expr.agg_dense.Domain.bind")
    *(".text.core.expr.agg_dense.Axis.sameDictionary" ".text..Lcore.expr.agg_dense.Axis.sameDictionary")
    *(".text.core.expr.agg_dense.Lanes.foldNumeric" ".text..Lcore.expr.agg_dense.Lanes.foldNumeric")
    *(".text.core.expr.agg_dense.Lanes.ensure" ".text..Lcore.expr.agg_dense.Lanes.ensure")
    *(".text.core.expr.eval.ExactPlan.add" ".text..Lcore.expr.eval.ExactPlan.add")
    *(".text.core.expr.ast.Expr.eql" ".text..Lcore.expr.ast.Expr.eql")
    *(".text.core.expr.eval.ExactPlan.evaluate" ".text..Lcore.expr.eval.ExactPlan.evaluate")
    *(".text.core.expr.eval.exactColumn" ".text..Lcore.expr.eval.exactColumn")
    *(".text.compiler_rt.udivmod.__udivti3" ".text..Lcompiler_rt.udivmod.__udivti3")
    *(".text.core.expr.eval.decBinOpLaneCached" ".text..Lcore.expr.eval.decBinOpLaneCached")
    *(".text.core.expr.eval.decOperandCached" ".text..Lcore.expr.eval.decOperandCached")
    *(".text.core.expr.eval.columnHasNullRows" ".text..Lcore.expr.eval.columnHasNullRows")
    *(".text.core.expr.eval.decColumnAt" ".text..Lcore.expr.eval.decColumnAt")
    *(".text.core.expr.eval.literalAsColumn" ".text..Lcore.expr.eval.literalAsColumn")
    *(".text.core.expr.eval.decKernel__func_*" ".text..Lcore.expr.eval.decKernel__func_*")
    *(".text.core.expr.agg_coded.foldGroupedCallWithContext__func_*" ".text..Lcore.expr.agg_coded.foldGroupedCallWithContext__func_*")
    *(".text.Io.Threaded.futexWaitUncancelable" ".text..LIo.Threaded.futexWaitUncancelable")
    *(".text.Io.Threaded.futexWake" ".text..LIo.Threaded.futexWake")
    *(".text.core.parquet.page.DecodeScratch.deinit" ".text..Lcore.parquet.page.DecodeScratch.deinit")
    *(".text.core.huge_pages.Region.regionFree" ".text..Lcore.huge_pages.Region.regionFree")
    *(".text.core.row_group_arena.RowGroupArena.deinit" ".text..Lcore.row_group_arena.RowGroupArena.deinit")
    *(".text.core.scan.worker.releaseRegionsParallel" ".text..Lcore.scan.worker.releaseRegionsParallel")
    *(".text.core.scan.worker.retireRegions" ".text..Lcore.scan.worker.retireRegions")
    *(".text.core.scan.private_decode.PrivateDecode.release" ".text..Lcore.scan.private_decode.PrivateDecode.release")
    *(".text.core.scan.worker.firstWorkerFailure" ".text..Lcore.scan.worker.firstWorkerFailure")
    *(".text.core.scan.census.denseFirst" ".text..Lcore.scan.census.denseFirst")
    *(".text.core.expr.agg_dense.intoTable" ".text..Lcore.expr.agg_dense.intoTable")
    *(".text.core.expr.agg_dense.mergeRanges" ".text..Lcore.expr.agg_dense.mergeRanges")
    *(".text.core.expr.agg_dense.MergeTask.run" ".text..Lcore.expr.agg_dense.MergeTask.run")
    *(".text.core.expr.agg_dense.reached" ".text..Lcore.expr.agg_dense.reached")
    *(".text.core.expr.agg_coded.keyDictColumn" ".text..Lcore.expr.agg_coded.keyDictColumn")
    *(".text.core.expr.eval.evalGroupKeyExpr" ".text..Lcore.expr.eval.evalGroupKeyExpr")
    *(".text.core.expr.agg_coded.serializeKeyAt" ".text..Lcore.expr.agg_coded.serializeKeyAt")
    *(".text.core.expr.aggregate.contracts.serializeRowKey" ".text..Lcore.expr.aggregate.contracts.serializeRowKey")
    *(".text.core.expr.aggregate.group_table.GroupTable.getOrInsert" ".text..Lcore.expr.aggregate.group_table.GroupTable.getOrInsert")
    *(".text.core.expr.aggregate.group_table.GroupTable.probeVariable" ".text..Lcore.expr.aggregate.group_table.GroupTable.probeVariable")
    *(".text.core.expr.aggregate.group_table.GroupTable.admit" ".text..Lcore.expr.aggregate.group_table.GroupTable.admit")
    *(".text.core.memory.SharedBudget.draw" ".text..Lcore.memory.SharedBudget.draw")
    *(".text.core.expr.aggregate.contracts.KeyArena.place" ".text..Lcore.expr.aggregate.contracts.KeyArena.place")
    *(".text.core.expr.aggregate.group_table.GroupTable.tryRemapList__func_*" ".text..Lcore.expr.aggregate.group_table.GroupTable.tryRemapList__func_*")
    *(".text.core.expr.aggregate.group_table.GroupTable.growFixedSlots" ".text..Lcore.expr.aggregate.group_table.GroupTable.growFixedSlots")
    *(".text.core.expr.aggregate.contracts.KeyArena.putParts" ".text..Lcore.expr.aggregate.contracts.KeyArena.putParts")
    *(".text.core.expr.aggregate.accumulator.Accumulator.init" ".text..Lcore.expr.aggregate.accumulator.Accumulator.init")
    *(".text.core.expr.agg_dense.deinitAll" ".text..Lcore.expr.agg_dense.deinitAll")
    *(".text.core.expr.agg_dense.Domain.deinit" ".text..Lcore.expr.agg_dense.Domain.deinit")
    *(".text.core.expr.agg_dense.Axis.deinit" ".text..Lcore.expr.agg_dense.Axis.deinit")
    *(".text.core.scan.rank_cut.resultCut" ".text..Lcore.scan.rank_cut.resultCut")
    *(".text.core.scan.merge.premergeLargeDistinctSets" ".text..Lcore.scan.merge.premergeLargeDistinctSets")
    *(".text.core.scan.merge.topKCandidates" ".text..Lcore.scan.merge.topKCandidates")
    *(".text.core.scan.rank_cut.resultLimitGroups" ".text..Lcore.scan.rank_cut.resultLimitGroups")
    *(".text.core.memory.Charged.alloc" ".text..Lcore.memory.Charged.alloc")
    *(".text.core.scan.merge.finishGroupRanges" ".text..Lcore.scan.merge.finishGroupRanges")
    *(".text.core.scan.merge.finishGroupRanges.Task.run" ".text..Lcore.scan.merge.finishGroupRanges.Task.run")
    *(".text.core.scan.binding.leafSchemaElem" ".text..Lcore.scan.binding.leafSchemaElem")
    *(".text.array_list.Aligned(core.scan.count_cut.MergedSlot,null).ensureTotalCapacity" ".text..Larray_list.Aligned(core.scan.count_cut.MergedSlot,null).ensureTotalCapacity")
    *(".text.core.scan.slot_sort.sortSlotsByFirst" ".text..Lcore.scan.slot_sort.sortSlotsByFirst")
    *(".text.core.scan.slot_sort.SlotRadix.runPhase" ".text..Lcore.scan.slot_sort.SlotRadix.runPhase")
    *(".text.core.scan.slot_sort.SlotRadix.run" ".text..Lcore.scan.slot_sort.SlotRadix.run")
    *(".text.core.memory.Charged.free" ".text..Lcore.memory.Charged.free")
    *(".text.core.scan.rows.pruneHaving" ".text..Lcore.scan.rows.pruneHaving")
    *(".text.core.scan.output.AggOutput.takeTableArenas" ".text..Lcore.scan.output.AggOutput.takeTableArenas")
    *(".text.core.scan.rows.RowSource.winnerStringBytes" ".text..Lcore.scan.rows.RowSource.winnerStringBytes")
    *(".text.core.scan.rows.answerBytesParallel" ".text..Lcore.scan.rows.answerBytesParallel")
    *(".text.core.scan.rows.RowSource.denseStringBytes" ".text..Lcore.scan.rows.RowSource.denseStringBytes")
    *(".text.core.scan.rows.buildGroupRows" ".text..Lcore.scan.rows.buildGroupRows")
    *(".text.core.scan.rows.RowBuildTask.run" ".text..Lcore.scan.rows.RowBuildTask.run")
    *(".text.core.scan.rows.RowSource.buildRow" ".text..Lcore.scan.rows.RowSource.buildRow")
    *(".text.core.scan.rows.RowSource.outputKey" ".text..Lcore.scan.rows.RowSource.outputKey")
    *(".text.core.scan.key_decode.deserializeKeyColumnMode" ".text..Lcore.scan.key_decode.deserializeKeyColumnMode")
    *(".text.core.scan.materialize.materializeOne" ".text..Lcore.scan.materialize.materializeOne")
    *(".text.core.expr.aggregate.types.avgDecMean" ".text..Lcore.expr.aggregate.types.avgDecMean")
    *(".text.core.expr.aggregate.types.resultDec" ".text..Lcore.expr.aggregate.types.resultDec")
    *(".text.core.expr.aggregate.group_table.GroupTable.deinitRange" ".text..Lcore.expr.aggregate.group_table.GroupTable.deinitRange")
    *(".text.core.expr.aggregate.group_table.GroupTable.deinitStorage" ".text..Lcore.expr.aggregate.group_table.GroupTable.deinitStorage")
    *(".text.core.scan.merge.freeAccumulatorRanges" ".text..Lcore.scan.merge.freeAccumulatorRanges")
    *(".text.core.scan.owned_merge.freeOwnedAccumulatorStrings" ".text..Lcore.scan.owned_merge.freeOwnedAccumulatorStrings")
    *(".text.core.expr.aggregate.accumulator.WinnerCharge.settle" ".text..Lcore.expr.aggregate.accumulator.WinnerCharge.settle")
    *(".text.core.expr.aggregate.group_table.GroupTable.deinit" ".text..Lcore.expr.aggregate.group_table.GroupTable.deinit")
    *(".text.heap.ArenaAllocator.deinit" ".text..Lheap.ArenaAllocator.deinit")
    *(".text.core.scan.worker_contracts.FailureProbe.releaseStream" ".text..Lcore.scan.worker_contracts.FailureProbe.releaseStream")
    *(".text.crypto.sha2.Sha2x32(.{ 1779033703, 3144134277, 1013904242, 2773480762, 1359893119, 2600822924, 528734635, 1541459225 },256).round" ".text..Lcrypto.sha2.Sha2x32(.{ 1779033703, 3144134277, 1013904242, 2773480762, 1359893119, 2600822924, 528734635, 1541459225 },256).round")
    *(".text.crypto.sha2.Sha2x32(.{ 1779033703, 3144134277, 1013904242, 2773480762, 1359893119, 2600822924, 528734635, 1541459225 },256).final" ".text..Lcrypto.sha2.Sha2x32(.{ 1779033703, 3144134277, 1013904242, 2773480762, 1359893119, 2600822924, 528734635, 1541459225 },256).final")
    *(".text.engine.aggregate.answerAggregate" ".text..Lengine.aggregate.answerAggregate")
    *(".text.core.system.discoverAvailableParallelism" ".text..Lcore.system.discoverAvailableParallelism")
    *(".text.core.scan.output.AggOutput.applyResultOrder" ".text..Lcore.scan.output.AggOutput.applyResultOrder")
    *(".text.core.result_program.ResultProgram.project" ".text..Lcore.result_program.ResultProgram.project")
    *(".text.core.scan.output.AggOutput.compactRows" ".text..Lcore.scan.output.AggOutput.compactRows")
    *(".text.engine.aggregate.executeAggregateOver__func_*__struct_1832.check" ".text..Lengine.aggregate.executeAggregateOver__func_*__struct_1832.check")
    *(".text.local_fs.Mapped.intact" ".text..Llocal_fs.Mapped.intact")
    *(".text.handler.runAggregate.Envelope.write" ".text..Lhandler.runAggregate.Envelope.write")
    *(".text.handler.aggregateResponse" ".text..Lhandler.aggregateResponse")
    *(".text.handler.Capped.alloc" ".text..Lhandler.Capped.alloc")
    *(".text.handler.Capped.remap" ".text..Lhandler.Capped.remap")
    *(".text.engine.text.AggregateTextEmitter(\*Io.Writer).beginRow" ".text..Lengine.text.AggregateTextEmitter(\*Io.Writer).beginRow")
    *(".text.engine.text.AggregateTextEmitter(\*Io.Writer).field" ".text..Lengine.text.AggregateTextEmitter(\*Io.Writer).field")
    *(".text.engine.json_string.writeJsonString__func_*" ".text..Lengine.json_string.writeJsonString__func_*")
    *(".text.engine.text.writeTypedAggValueJson__func_*" ".text..Lengine.text.writeTypedAggValueJson__func_*")
    *(".text.engine.text.writeBytesJson__func_*" ".text..Lengine.text.writeBytesJson__func_*")
    *(".text.engine.json_string.escapeJson__func_*" ".text..Lengine.json_string.escapeJson__func_*")
    *(".text.engine.text.writeDecimal__func_*" ".text..Lengine.text.writeDecimal__func_*")
    *(".text.Io.Writer.printValue__func_*" ".text..LIo.Writer.printValue__func_*")
    *(".text.Io.Writer.alignBuffer" ".text..LIo.Writer.alignBuffer")
    *(".text.Io.Writer.print__func_*" ".text..LIo.Writer.print__func_*")
    *(".text.engine.text.writeJsonQuoted__func_*" ".text..Lengine.text.writeJsonQuoted__func_*")
    *(".text.engine.text.writeMembershipJson__func_*" ".text..Lengine.text.writeMembershipJson__func_*")
    *(".text.handler.writePoolStats" ".text..Lhandler.writePoolStats")
    *(".text.fmt.float.render__func_*" ".text..Lfmt.float.render__func_*")
    *(".text.engine.input.OpenedInputs.deinit" ".text..Lengine.input.OpenedInputs.deinit")
    *(".text.local_fs.Mapped.unmap" ".text..Llocal_fs.Mapped.unmap")
    *(".text.core.scan.output.AggOutput.deinit" ".text..Lcore.scan.output.AggOutput.deinit")
    *(".text.core.scan.output.AggOutput.releaseRow" ".text..Lcore.scan.output.AggOutput.releaseRow")
    *(".text.request.Request.deinit" ".text..Lrequest.Request.deinit")
    *(".text.runtime.Client.postTo" ".text..Lruntime.Client.postTo")
    *(".text.__pthread_join" ".text..L__pthread_join")
    *(".text.__pthread_timedjoin_np" ".text..L__pthread_timedjoin_np")
    *(".text.__pthread_testcancel" ".text..L__pthread_testcancel")
    *(".text.__testcancel" ".text..L__testcancel")
    *(".text.__tl_sync" ".text..L__tl_sync")
    *(".text.heap.PageAllocator.alloc" ".text..Lheap.PageAllocator.alloc")
    *(".text.heap.PageAllocator.free" ".text..Lheap.PageAllocator.free")
    *(".text.engine.input.RemoteInputs.open" ".text..Lengine.input.RemoteInputs.open")
    *(".text.io.s3.Url.parse" ".text..Lio.s3.Url.parse")
    *(".text.handler.persistentPoolAdapter.Wrapper.ensure" ".text..Lhandler.persistentPoolAdapter.Wrapper.ensure")
    *(".text.engine.s3_fetch.footerProbeFor" ".text..Lengine.s3_fetch.footerProbeFor")
    *(".text.Io.Threaded.groupConcurrent" ".text..LIo.Threaded.groupConcurrent")
    *(".text.Thread.spawn__func_*" ".text..LThread.spawn__func_*")
    *(".text.__pthread_self_internal" ".text..L__pthread_self_internal")
    *(".text.__pthread_detach" ".text..L__pthread_detach")
    *(".text.Io.Threaded.groupAwait" ".text..LIo.Threaded.groupAwait")
    *(".text.unlikely.Io.Threaded.Thread.futexWaitInner" ".text.unlikely..LIo.Threaded.Thread.futexWaitInner")
    *(".text.Io.Threaded.Group.Task.start" ".text..LIo.Threaded.Group.Task.start")
    *(".text.Io.Group.concurrent__func_*.TypeErased.start" ".text..LIo.Group.concurrent__func_*.TypeErased.start")
    *(".text.engine.s3_fetch.fetchMetaBatch.Item.run" ".text..Lengine.s3_fetch.fetchMetaBatch.Item.run")
    *(".text.engine.s3_fetch.getMetaObject" ".text..Lengine.s3_fetch.getMetaObject")
    *(".text.io.pool.Pool(64).acquire" ".text..Lio.pool.Pool(64).acquire")
    *(".text.Io.TypeErasedQueue.getLocked" ".text..LIo.TypeErasedQueue.getLocked")
    *(".text.Io.TypeErasedQueue.fillRingBufferFromPutters" ".text..LIo.TypeErasedQueue.fillRingBufferFromPutters")
    *(".text.io.pool.Pool(64).acquireWithPermit" ".text..Lio.pool.Pool(64).acquireWithPermit")
    *(".text.io.s3.sessionCredentialsWait" ".text..Lio.s3.sessionCredentialsWait")
    *(".text.io.s3.buildAndSend" ".text..Lio.s3.buildAndSend")
    *(".text.io.s3.pathFor" ".text..Lio.s3.pathFor")
    *(".text.io.s3.Range.writeHeader" ".text..Lio.s3.Range.writeHeader")
    *(".text.io.sigv4.SigV4.sign" ".text..Lio.sigv4.SigV4.sign")
    *(".text.io.sigv4.hashSha256Hex" ".text..Lio.sigv4.hashSha256Hex")
    *(".text.io.sigv4.hmacSha256" ".text..Lio.sigv4.hmacSha256")
    *(".text.array_list.Aligned(io.sigv4.SigV4.Header,null).toOwnedSlice" ".text..Larray_list.Aligned(io.sigv4.SigV4.Header,null).toOwnedSlice")
    *(".text.io.http.sendRequest" ".text..Lio.http.sendRequest")
    *(".text.io.http.bodyCap" ".text..Lio.http.bodyCap")
    *(".text.io.http.sendRequestBytes" ".text..Lio.http.sendRequestBytes")
    *(".text.io.tls.Connection.writeSocket" ".text..Lio.tls.Connection.writeSocket")
    *(".text.io.http.recvResponseBytes" ".text..Lio.http.recvResponseBytes")
    *(".text.io.tls.Connection.readSocket" ".text..Lio.tls.Connection.readSocket")
    *(".text.io.http.finalHeadEnd" ".text..Lio.http.finalHeadEnd")
    *(".text.io.http.parseContentLength" ".text..Lio.http.parseContentLength")
    *(".text.io.http.parseTransferEncodingChunked" ".text..Lio.http.parseTransferEncodingChunked")
    *(".text.io.http.parseHeaders" ".text..Lio.http.parseHeaders")
    *(".text.io.pool.Pool(64).releaseConnection" ".text..Lio.pool.Pool(64).releaseConnection")
    *(".text.Io.Queue(usize).putOneUncancelable" ".text..LIo.Queue(usize).putOneUncancelable")
    *(".text.io.pool.Pool(64).noteS3" ".text..Lio.pool.Pool(64).noteS3")
    *(".text.io.s3.RequestTrace.end" ".text..Lio.s3.RequestTrace.end")
    *(".text.engine.s3_fetch.populateFromTailResponse__func_*" ".text..Lengine.s3_fetch.populateFromTailResponse__func_*")
    *(".text.engine.s3_fetch.ByteAccount.tryAdd" ".text..Lengine.s3_fetch.ByteAccount.tryAdd")
    *(".text.engine.s3_fetch.maybeCacheMeta" ".text..Lengine.s3_fetch.maybeCacheMeta")
    *(".text.hash_map.Custom(\[\]const u8,\*io.meta_cache.Entry,hash_map.StringContext,80).fetchRemove" ".text..Lhash_map.Custom(\[\]const u8,\*io.meta_cache.Entry,hash_map.StringContext,80).fetchRemove")
    *(".text.unlikely.hash_map.Custom(\[\]const u8,\*io.meta_cache.Entry,hash_map.StringContext,80).grow" ".text.unlikely..Lhash_map.Custom(\[\]const u8,\*io.meta_cache.Entry,hash_map.StringContext,80).grow")
    *(".text.engine.projection.bindFilter" ".text..Lengine.projection.bindFilter")
    *(".text.engine.s3_fetch.S3Membership.init" ".text..Lengine.s3_fetch.S3Membership.init")
    *(".text.io.s3.inFlight" ".text..Lio.s3.inFlight")
    *(".text.engine.s3_fetch.S3Membership.source" ".text..Lengine.s3_fetch.S3Membership.source")
    *(".text.engine.s3_fetch.S3Membership.measured" ".text..Lengine.s3_fetch.S3Membership.measured")
    *(".text.engine.s3_fetch.appendRgFetchRanges" ".text..Lengine.s3_fetch.appendRgFetchRanges")
    *(".text.array_list.Aligned(io.coalescer.Range,null).append" ".text..Larray_list.Aligned(io.coalescer.Range,null).append")
    *(".text.io.coalescer.coalesceDispatch" ".text..Lio.coalescer.coalesceDispatch")
    *(".text.mem.swap__func_*" ".text..Lmem.swap__func_*")
    *(".text.engine.s3_fetch.orderFilterFirst" ".text..Lengine.s3_fetch.orderFilterFirst")
    *(".text.engine.s3_fetch.releaseChargedTail" ".text..Lengine.s3_fetch.releaseChargedTail")
    *(".text.io.s3.firstWaveCap" ".text..Lio.s3.firstWaveCap")
    *(".text.io.s3.fetchJobs__func_*" ".text..Lio.s3.fetchJobs__func_*")
    *(".text.hash_map.Custom(\[\]const u8,io.s3.fetchJobs__func_*.HostInfo,hash_map.StringContext,80).get" ".text..Lhash_map.Custom(\[\]const u8,io.s3.fetchJobs__func_*.HostInfo,hash_map.StringContext,80).get")
    *(".text.unlikely.hash_map.Custom(\[\]const u8,io.s3.fetchJobs__func_*.HostInfo,hash_map.StringContext,80).grow" ".text.unlikely..Lhash_map.Custom(\[\]const u8,io.s3.fetchJobs__func_*.HostInfo,hash_map.StringContext,80).grow")
    *(".text.io.s3.fetchOneTask" ".text..Lio.s3.fetchOneTask")
    *(".text.io.pool.AnyPool.of__func_*.gen.vtable__struct_13164.f" ".text..Lio.pool.AnyPool.of__func_*.gen.vtable__struct_13164.f")
    *(".text.io.s3.noteDataHeader" ".text..Lio.s3.noteDataHeader")
    *(".text.io.pool.AnyPool.of__func_*.gen.vtable__struct_13165.f" ".text..Lio.pool.AnyPool.of__func_*.gen.vtable__struct_13165.f")
    *(".text.io.pool.AnyPool.of__func_*.gen.vtable__struct_13168.f" ".text..Lio.pool.AnyPool.of__func_*.gen.vtable__struct_13168.f")
    *(".text.Io.Threaded.deinit" ".text..LIo.Threaded.deinit")
    *(".text.__block_all_sigs" ".text..L__block_all_sigs")
    *libc.a:*__unmapself.o(.text)
    *(".text.core.scan.owner_packed.inlineSelectedCount__func_*" ".text..Lcore.scan.owner_packed.inlineSelectedCount__func_*")
    *(".text.core.agg_plan.Plan.forCalls" ".text..Lcore.agg_plan.Plan.forCalls")
    *(".text.core.scan.execute.splitRowGroups" ".text..Lcore.scan.execute.splitRowGroups")
    *(".text.core.expr.agg_state.State.configure" ".text..Lcore.expr.agg_state.State.configure")
    *(".text.core.consumer.scan.foldGroupedWindows" ".text..Lcore.consumer.scan.foldGroupedWindows")
    *(".text.core.expr.agg_coded.groupedCodedWithContext" ".text..Lcore.expr.agg_coded.groupedCodedWithContext")
    *(".text.core.expr.agg_coded.foldExactBatch" ".text..Lcore.expr.agg_coded.foldExactBatch")
    *(".text.core.row_group_arena.RowGroupArena.resize" ".text..Lcore.row_group_arena.RowGroupArena.resize")
    *(".text.core.filter.eval.Batch.Column.sliceRows" ".text..Lcore.filter.eval.Batch.Column.sliceRows")
    *(".text.core.expr.agg_coded.NarrowAcc.fold" ".text..Lcore.expr.agg_coded.NarrowAcc.fold")
    *(".text.heap.ArenaAllocator.resize" ".text..Lheap.ArenaAllocator.resize")
    *(".text.core.expr.agg_coded.NarrowAcc.finish" ".text..Lcore.expr.agg_coded.NarrowAcc.finish")
    *(".text.core.expr.agg_coded.foldGroupedValue__func_*" ".text..Lcore.expr.agg_coded.foldGroupedValue__func_*")
    *(".text.core.partagg.PartAgg.pump" ".text..Lcore.partagg.PartAgg.pump")
    *(".text.core.partagg.PartAgg.deinit" ".text..Lcore.partagg.PartAgg.deinit")
    *(".text.core.partagg.Run.free" ".text..Lcore.partagg.Run.free")
    *(".text.fmt.allocPrint__func_*" ".text..Lfmt.allocPrint__func_*")
    *(".text.engine.join.Prepared.intact" ".text..Lengine.join.Prepared.intact")
    *(".text.core.scan.owner_packed.selectedCountBits__func_*" ".text..Lcore.scan.owner_packed.selectedCountBits__func_*")
    *(".text.core.owner_cache.Local(core.owner_lanes.Layout(u64,&.{ .max, .max, .max }\[0..3\],u32).CachePolicy).flush__func_*" ".text..Lcore.owner_cache.Local(core.owner_lanes.Layout(u64,&.{ .max, .max, .max }\[0..3\],u32).CachePolicy).flush__func_*")
    *(".text.engine.aggregate.traceTail" ".text..Lengine.aggregate.traceTail")
    *(".text.__cxa_atexit" ".text..L__cxa_atexit")
    *(".text.core.scan.typed_answer.TypedAnswer.deinit" ".text..Lcore.scan.typed_answer.TypedAnswer.deinit")
    *(".text.core.owner_sink.Packed(u64,&.{.max}\[0..1\],u32).batchErased" ".text..Lcore.owner_sink.Packed(u64,&.{.max}\[0..1\],u32).batchErased")
    *(".text.priority_queue.PriorityQueue(core.owner_lanes.Layout(u64,&.{ .max, .present_count }\[0..2\],u32).Group,bool,(function 'worse')).push" ".text..Lpriority_queue.PriorityQueue(core.owner_lanes.Layout(u64,&.{ .max, .present_count }\[0..2\],u32).Group,bool,(function 'worse')).push")
    *(".text.core.owner_packed.Framework(core.owner_lanes.Layout(u64,&.{ .max, .present_count }\[0..2\],u32),u32,(function 'hashRecord')).State.finish__func_*.Task.run" ".text..Lcore.owner_packed.Framework(core.owner_lanes.Layout(u64,&.{ .max, .present_count }\[0..2\],u32),u32,(function 'hashRecord')).State.finish__func_*.Task.run")
    *(".text.core.owner_result.Top(core.owner_lanes.Layout(u64,&.{ .max, .present_count }\[0..2\],u32).Group,bool,(function 'worse')).Receiver.offer" ".text..Lcore.owner_result.Top(core.owner_lanes.Layout(u64,&.{ .max, .present_count }\[0..2\],u32).Group,bool,(function 'worse')).Receiver.offer")
    *(".text.core.owner_sink.Packed(u64,&.{.max}\[0..1\],u32).batch.Callback.append" ".text..Lcore.owner_sink.Packed(u64,&.{.max}\[0..1\],u32).batch.Callback.append")
    *(".text.core.owner_lanes.Layout(u64,&.{.max}\[0..1\],u32).CachePolicy.coalesce" ".text..Lcore.owner_lanes.Layout(u64,&.{.max}\[0..1\],u32).CachePolicy.coalesce")
    *(".text.core.owner_packed.Framework(core.owner_lanes.Layout(u64,&.{.max}\[0..1\],u32),u32,(function 'hashRecord')).State.deinit" ".text..Lcore.owner_packed.Framework(core.owner_lanes.Layout(u64,&.{.max}\[0..1\],u32),u32,(function 'hashRecord')).State.deinit")
    *(".text.core.owner_packed.Framework(core.owner_lanes.Layout(u64,&.{.max}\[0..1\],u32),u32,(function 'hashRecord')).State.chargeStorage" ".text..Lcore.owner_packed.Framework(core.owner_lanes.Layout(u64,&.{.max}\[0..1\],u32),u32,(function 'hashRecord')).State.chargeStorage")
    *(".text.core.owner_result.Top(core.owner_lanes.Layout(u64,&.{ .max, .present_count }\[0..2\],u32).Group,bool,(function 'worse')).finish" ".text..Lcore.owner_result.Top(core.owner_lanes.Layout(u64,&.{ .max, .present_count }\[0..2\],u32).Group,bool,(function 'worse')).finish")
    *(".text.core.expr.key_plan.Plan.Bound.forEachSelected__func_*" ".text..Lcore.expr.key_plan.Plan.Bound.forEachSelected__func_*")
    *(".text.engine.write.FdSink.copyRangeFn" ".text..Lengine.write.FdSink.copyRangeFn")
    *(".text.engine.projection.planProjection" ".text..Lengine.projection.planProjection")
    *(".text.core.owner_sink.Packed(u64,&.{ .max, .present_count, .present_count, .present_count }\[0..4\],u32).batchErased" ".text..Lcore.owner_sink.Packed(u64,&.{ .max, .present_count, .present_count, .present_count }\[0..4\],u32).batchErased")
    *(.text .text.*)
  }
}
INSERT AFTER .rodata;
